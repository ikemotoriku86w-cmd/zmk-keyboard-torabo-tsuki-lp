/{
    split_inputs {
        #address-cells = <1>;
        #size-cells = <0>;

        pointing_device_split: pointing_device_split@0 {
            compatible = "zmk,input-split";
            reg = <0>;
            device = <&pointing_device>;
        };
    };
};

// 左トラボ(常時スクロール)は左手が触れると誤スクロールしやすいため、
// センサー感度を下げて軽い接触での誤発火を抑える。
// このスニペットは double_ball_left_peripheral のみで使われるため左だけに効く。
// res-cpi の有効範囲は 608〜4826(38刻み)。値を上げれば敏感に戻る。
&pointing_device {
    res-cpi = <608>;
};
